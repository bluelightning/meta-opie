## conf/layer.conf
```bitbake
# Layer configuration for meta-opie layer
# Copyright 2011 Intel Corporation

# We have a conf and classes directory, prepend to BBPATH to prefer our versions
BBPATH =. "${LAYERDIR}:"

# We have a recipes directory, add to BBFILES
BBFILES += "${LAYERDIR}/recipes-*/*/*.bb ${LAYERDIR}/recipes-*/*/*.bbappend"

BBFILE_COLLECTIONS += "meta-opie"
BBFILE_PATTERN_meta-opie := "^${LAYERDIR}/"
BBFILE_PRIORITY_meta-opie = "8"

LAYERDEPENDS_meta-opie = "core"
LAYERDEPENDS_meta-opie += "openembedded-layer"
LAYERDEPENDS_meta-opie += "networking-layer"

# Some basic definitions
OPIE_GIT = "git://gitorious.org/opie/opie.git"

# Prevent parse errors when the user has neglected to include a file from conf/distro/include/
OPIE_GIT_PV ??= ""
OPIE_SRCREV ??= ""
```
